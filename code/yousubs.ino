#include <TFT_eSPI.h>
#include <pgmspace.h>
#include <WiFi.h>
#include <WebServer.h>
#include <EEPROM.h>
#include <TJpg_Decoder.h>
#include <FS.h>
#include "SPIFFS.h"
#include <WiFi.h>
#include <HTTPClient.h>
#include "Web_Fetch.h"
#include <ArduinoJson.h>
#include "Free_Fonts.h"

#define FS_NO_GLOBALS

#define EEPROM_SIZE 512
#define WIFI_SSID_ADDR 0
#define WIFI_PASS_ADDR 100
#define NOME_CANALE_ADDR 200
#define API_KEY_ADDR 300
#define MAX_LEN 100

const unsigned char epd_bitmap_yousub[] PROGMEM = {
    0x00, 0x00, 0x00, 0x00, 0x00, 0x00, 0x00, 0x00, 0x00, 0x00, 0x00, 0x00, 0x00, 0x00, 0x00, 0x00,
    0x00, 0x00, 0x00, 0x00, 0x00, 0x00, 0x00, 0x00, 0x00, 0x00, 0x00, 0x00, 0x00, 0x00, 0x00, 0x00,
    0x00, 0x00, 0x00, 0x00, 0x00, 0x00, 0x00, 0x00, 0x00, 0x00, 0x00, 0x00, 0x00, 0x00, 0x00, 0x00,
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    0x00, 0x00, 0x00, 0x00, 0x00, 0x00, 0x00, 0x00, 0x00, 0x00, 0x00, 0x00, 0x00, 0x00, 0x00, 0x00};

const int epd_bitmap_allArray_LEN = 1;
const unsigned char *epd_bitmap_allArray[1] = {
    epd_bitmap_yousub};

const int bitmapWidth = 240;
const int bitmapHeight = 240;

char ssid[MAX_LEN];
char password[MAX_LEN];
char nomeCanale[MAX_LEN];
char api_key[MAX_LEN];

const char *ap_ssid = "YouSubs-Setup";
const char *ap_password = "12345678";
String channelId = "";

int sub = 0;

const long interval = 60000;
unsigned long previousMillis = 0;

WebServer server(80);

TFT_eSPI tft = TFT_eSPI();

void setupWebServer()
{
  server.on("/", HTTP_GET, []()
            {
    String htmlWithCSS = R"html(
<html>
  <head>
    <style>
      body {
        font-family: Arial, sans-serif;
        background-color: #f9f9f9;
        text-align: center;
        padding: 50px;
        display: flex;
        flex-direction: column;
        align-items: center;
      }
      h1 {
        color: #333;
      }
      form {
        background-color: #ffffff;
        padding: 20px;
        border-radius: 8px;
        box-shadow: 0 4px 6px rgba(0,0,0,0.1);
        display: flex;
        flex-direction: column;
        max-width: 400px;
        width: 100%;
      }
      input[type='text'] {
        width: 100%;
        padding: 10px;
        margin: 10px 0;
        border: 1px solid #ccc;
        border-radius: 4px;
      }
      input[type='submit'] {
        background-color: #28a745;
        color: white;
        padding: 10px 20px;
        border: none;
        border-radius: 4px;
        cursor: pointer;
      }
      input[type='submit']:hover {
        background-color: #218838;
      }
    </style>
  </head>
  <body>
    <h1>Configurazione YouSubs</h1>
    <form action='/save' method='POST'>
      Wi-Fi SSID: <input type='text' name='ssid' value='%(ssid)%'><br>
      Wi-Fi Password: <input type='password' name='password' value='%(password)%'><br>
      Nome Canale: <input type='text' name='nomeCanale' value='%(nomeCanale)%'><br>
      API Key: <input type='text' name='api_key' value='%(apiKey)%'><br>
      <input type='submit' value='Salva'>
    </form>
  </body>
</html>
)html";
    htmlWithCSS.replace("%(ssid)%", ssid);
    htmlWithCSS.replace("%(apiKey)%", api_key);
    htmlWithCSS.replace("%(password)%", password);
    htmlWithCSS.replace("%(nomeCanale)%", nomeCanale);

    server.send(200, "text/html", htmlWithCSS); });

  server.on("/save", HTTP_POST, []()
            {
    String newSSID = server.arg("ssid");
    String newPassword = server.arg("password");
    String newNomeCanale = server.arg("nomeCanale");
    String newAPIKey = server.arg("api_key");

    saveToEEPROM(WIFI_SSID_ADDR, newSSID);
    saveToEEPROM(WIFI_PASS_ADDR, newPassword);
    saveToEEPROM(NOME_CANALE_ADDR, newNomeCanale);
    saveToEEPROM(API_KEY_ADDR, newAPIKey);

    server.send(200, "text/html", "<h1>Impostazioni Salvate!</h1><a href='/'>Torna alla configurazione</a>");
    ESP.restart(); });

  server.begin();
  Serial.println("Web server avviato!");
}

void saveToEEPROM(int addr, String value)
{
  for (int i = 0; i < value.length(); i++)
  {
    EEPROM.write(addr + i, value[i]);
  }
  EEPROM.write(addr + value.length(), '\0');
  EEPROM.commit();
}

void readFromEEPROM(int addr, char *buffer, int maxLen)
{
  for (int i = 0; i < maxLen; i++)
  {
    char c = EEPROM.read(addr + i);
    if (c == '\0')
    {
      buffer[i] = '\0';
      break;
    }
    buffer[i] = c;
  }
}

void readSettings()
{
  readFromEEPROM(WIFI_SSID_ADDR, ssid, MAX_LEN);
  readFromEEPROM(WIFI_PASS_ADDR, password, MAX_LEN);
  readFromEEPROM(NOME_CANALE_ADDR, nomeCanale, MAX_LEN);
  readFromEEPROM(API_KEY_ADDR, api_key, MAX_LEN);
}

bool tft_output(int16_t x, int16_t y, uint16_t w, uint16_t h, uint16_t *bitmap)
{
  if (y >= tft.height())
    return 0;
  tft.pushImage(x, y, w, h, bitmap);
  return 1;
}

void fetchUserImage(String url)
{
  if (!SPIFFS.begin())
  {
    while (1)
      yield();
  }

  TJpgDec.setJpgScale(1);

  TJpgDec.setSwapBytes(true);
  TJpgDec.setCallback(tft_output);

  if (SPIFFS.exists("/M81.jpg") == true)
  {
    SPIFFS.remove("/M81.jpg");
  }

  bool loaded_ok = getFile(url, "/M81.jpg");

  if (!loaded_ok)
  {

    Serial.println("Fetch error...");
  }

  tft.fillRect(0, 0, tft.width(), 100, TFT_BLACK);
  int imgX = 80;
  int imgY = 10;
  int imgSize = 88;

  int centerX = imgX + imgSize / 2;
  int centerY = imgY + imgSize / 2;
  TJpgDec.drawFsJpg(imgX, imgY, "/M81.jpg");

  for (int r = imgSize / 2; r < (sqrt(pow(imgSize, 2) + pow(imgSize, 2))) / 2; r++)
  {
    for (float angle = 0; angle < 360; angle += 0.5)
    {
      int x = centerX + r * cos(angle * PI / 180);
      int y = centerY + r * sin(angle * PI / 180);
      tft.drawPixel(x, y, TFT_BLACK);
    }
  }
}

StaticJsonDocument<1024> fetchYouTubeData(const char *endpoint, const String &queryParams, const char *apiKey)
{
  StaticJsonDocument<1024> jsonDoc;

  if (WiFi.status() == WL_CONNECTED)
  {
    HTTPClient http;
    String url = String(endpoint) + "?" + queryParams + "&key=" + String(apiKey);
    Serial.println("URL richiesta: " + url);

    if (WiFi.status() != WL_CONNECTED)
    {
      Serial.println("Connessione Wi-Fi persa!");
      return jsonDoc;
    }
    http.begin(url);
    int httpCode = http.GET();

    if (httpCode == HTTP_CODE_OK)
    {
      String payload = http.getString();
      Serial.println("JSON ricevuto:");
      Serial.println(payload);

      DeserializationError error = deserializeJson(jsonDoc, payload);
      if (error)
      {
        Serial.print("Errore di parsing JSON: ");
        Serial.println(error.c_str());
      }
    }
    else
    {
      Serial.print("Errore HTTP: ");
      Serial.println(httpCode);
    }

    http.end();
  }
  else
  {
    Serial.println("Wi-Fi non connesso!");
  }

  return jsonDoc;
}

void updateSubs()
{
  String queryParams = String("part=statistics&id=") + channelId;
  StaticJsonDocument<1024> jsonResponse = fetchYouTubeData("https://www.googleapis.com/youtube/v3/channels", queryParams, api_key);
  if (!jsonResponse.isNull())
  {
    int newSub = atoi(jsonResponse["items"][0]["statistics"]["subscriberCount"]);
    if (sub != newSub)
    {
      sub = newSub;
      tft.fillRect(0, 100, 240, 140, TFT_BLACK);
      tft.setFreeFont(FSS24);
      int nLen = tft.textWidth(String(sub));
      tft.drawString(String(sub), (tft.width() - nLen) / 2, tft.height() / 2);
      tft.drawString("Subscribers", (tft.width() - tft.textWidth("Subscribers", 4)) / 2, tft.height() - 30, 4);
    }
  }
  else
  {
    Serial.println("Errore nel JSON o valore assente!");
  }
}

void setup()
{
  Serial.begin(115200);
  tft.init();
  tft.setRotation(1);
  tft.fillScreen(TFT_BLACK);
  tft.setTextColor(TFT_WHITE, TFT_BLACK);
  tft.fillRoundRect(22, 96, 63, 43, 10, TFT_RED);
  tft.drawBitmap(0, 0, epd_bitmap_yousub, bitmapWidth, bitmapHeight, TFT_WHITE);
  delay(1000);

  EEPROM.begin(EEPROM_SIZE);
  readSettings();

  Serial.println("Connessione al Wi-Fi...");
  WiFi.begin(ssid, password);

  unsigned long startTime = millis();
  while (WiFi.status() != WL_CONNECTED && millis() - startTime < 10000)
  {
    Serial.print(".");
    delay(500);
  }

  if (WiFi.status() == WL_CONNECTED)
  {
    Serial.println("\nConnesso al Wi-Fi!");
    Serial.print("Indirizzo IP: ");
    Serial.println(WiFi.localIP());

    tft.fillScreen(TFT_BLACK);
    tft.setCursor(10, tft.height() / 2 - 10);
    tft.drawString("Indirizzo IP:", 10, 10, 4);
    tft.drawString(WiFi.localIP().toString(), 10, tft.height() / 2 - 20, 4);
    delay(5000);

    String queryParams = String("part=snippet&forHandle=") + nomeCanale;

    StaticJsonDocument<1024> jsonResponse = fetchYouTubeData("https://www.googleapis.com/youtube/v3/channels", queryParams, api_key);
    if (!jsonResponse.isNull())
    {
      if (jsonResponse.containsKey("items") && jsonResponse["items"][0].containsKey("snippet") && jsonResponse["items"][0]["snippet"].containsKey("thumbnails") && jsonResponse["items"][0]["snippet"]["thumbnails"].containsKey("default") && jsonResponse["items"][0]["snippet"]["thumbnails"]["default"].containsKey("url") && jsonResponse["items"][0].containsKey("id"))
      {

        const String imageUrl = jsonResponse["items"][0]["snippet"]["thumbnails"]["default"]["url"];
        channelId = String(jsonResponse["items"][0]["id"].as<const char *>());
        tft.fillScreen(TFT_BLACK);
        fetchUserImage(imageUrl);
        updateSubs();
      }
      else
      {
        tft.fillScreen(TFT_BLACK);
        tft.drawString("Missing keys...", 10, 10, 4);
      }
    }
    else
    {
      tft.fillScreen(TFT_BLACK);
      tft.drawString("Error...", 10, 10, 4);
    }
  }
  else
  {
    Serial.println("\nImpossibile connettersi al Wi-Fi. Attivazione modalità AP...");
    WiFi.softAP(ap_ssid, ap_password);
    Serial.print("Indirizzo IP AP: ");
    Serial.println(WiFi.softAPIP());

    tft.fillScreen(TFT_BLACK);
    tft.setCursor(10, tft.height() / 2 - 10);
    tft.drawString("Indirizzo IP AP:", 10, 10, 4);
    tft.drawString(WiFi.softAPIP().toString(), 10, tft.height() / 2 - 20, 4);
  }

  setupWebServer();
}

void loop()
{
  unsigned long currentMillis = millis();
  if (currentMillis - previousMillis >= interval)
  {
    previousMillis = currentMillis;
    updateSubs();
  }
  server.handleClient();
}
